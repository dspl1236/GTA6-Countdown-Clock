// ============================================================
//  GTA VI Countdown — v6 · SSD1309 2.42" · ESP32 WROOM-32
//  Boot: VI logo pull-back into Miami scene (reused as drive-by)
//  Clock: split-flap board + rotating strips (facts/stars/bullets)
//  Pins: CS=5, DC=15, RST=4, MOSI=23, CLK=18
//  Author: dspl1236
// ============================================================

#include <U8g2lib.h>
#include <WiFi.h>
#include <time.h>

// ── WiFi ────────────────────────────────────────────────────
#define WIFI_SSID     "YOUR_WIFI_SSID"
#define WIFI_PASSWORD "YOUR_WIFI_PASSWORD"

// ── Pins ────────────────────────────────────────────────────
#define PIN_CS    5
#define PIN_DC   15
#define PIN_RST   4

// ── NTP ─────────────────────────────────────────────────────
#define NTP_SERVER       "pool.ntp.org"
#define NTP_FALLBACK     "time.nist.gov"
#define GMT_OFFSET_SEC   (-5 * 3600)
#define DAYLIGHT_OFFSET  3600
#define NTP_RESYNC_MS    (24UL * 60UL * 60UL * 1000UL)  // resync every 24h
#define NTP_RETRY_MS     (30UL * 1000UL)                 // boot retry if first sync missed
#define WIFI_ATTEMPT_MS  (12UL * 1000UL)                 // cap each connect attempt (non-blocking)

// ── Release: Nov 19 2026 00:00 EST ──────────────────────────
#define GTA6_RELEASE_UTC  1795064400UL

// ── Timing ──────────────────────────────────────────────────
#define STRIP_HOLD_MS   8000
#define NUM_STRIPS      3
#define DRIVEBY_INTERVAL_MS (3UL * 60UL * 1000UL)
#define CONTRAST   230
#define SPI_CLOCK  8000000UL

U8G2_SSD1309_128X64_NONAME0_F_4W_HW_SPI u8g2(
  U8G2_R0, PIN_CS, PIN_DC, PIN_RST
);

// ── VI logo bitmap (full screen, for zoom) ──────────────────
#define VILOGO_W 128
#define VILOGO_H 64
static const unsigned char vi_logo[] U8X8_PROGMEM = {
  0x00,0x00,0x00,0x00,0x00,0x00,0x00,0x00,0x00,0x00,0x00,0x00,0x00,0x00,0x00,0x00,
  0x00,0x00,0x00,0x00,0x00,0x00,0x00,0x00,0x00,0x00,0x00,0x00,0x00,0x00,0x00,0x00,
  0x00,0x00,0x00,0x00,0x00,0x00,0x00,0x00,0x00,0x00,0x00,0x00,0x00,0x00,0x00,0x00,
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  0x00,0x00,0x00,0x00,0x00,0x00,0x00,0x00,0x00,0x00,0x00,0x00,0x00,0x00,0x00,0x00,
};


// ── Wanted star sprites (filled + outline) ──
#define STAR_W 9
#define STAR_H 9
static const unsigned char star_filled[] U8X8_PROGMEM = {
  0x10,0x00,
  0x38,0x00,
  0x38,0x00,
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  0x82,0x00,
};
static const unsigned char star_outline[] U8X8_PROGMEM = {
  0x10,0x00,
  0x28,0x00,
  0x28,0x00,
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  0x82,0x00,
};

// ── Rockstar R-star logo (boot publisher card) ──
#define RSTAR_W 64
#define RSTAR_H 58
static const unsigned char rstar_logo[] U8X8_PROGMEM = {
  0x00,0x00,0x00,0x00,0x00,0x00,0x00,0x00,
  0x00,0x00,0x00,0x00,0x00,0x00,0x00,0x00,
  0x80,0xFF,0xFF,0x07,0x00,0x00,0x00,0x00,
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  0x00,0x00,0x00,0x00,0x00,0x00,0x00,0x00,
};

// ── Layered 'grand theft auto VI' logo (VI frames wordmark) ──
#define LOGO_W 128
#define LOGO_H 64
static const unsigned char gtavi_logo[] U8X8_PROGMEM = {
  0x00,0x00,0x00,0x00,0x00,0x00,0x00,0x00,0x00,0x00,0x00,0x00,0x00,0x00,0x00,0x00,
  0x00,0x00,0x00,0x00,0x00,0x00,0x00,0x00,0x00,0x00,0x00,0x00,0x00,0x00,0x00,0x00,
  0x00,0x00,0x00,0x00,0x00,0x00,0x00,0x00,0x00,0x00,0x00,0x00,0x00,0x00,0x00,0x00,
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  0x00,0x00,0x00,0x00,0x00,0x00,0x00,0x00,0x00,0x00,0x00,0x00,0x00,0x00,0x00,0x00,
};

// ── GTA wordmark only (no VI underlay) — title card ──
#define WORD_W 128
#define WORD_H 64
static const unsigned char gta_word[] U8X8_PROGMEM = {
  0x00,0x00,0x00,0x00,0x00,0x00,0x00,0x00,0x00,0x00,0x00,0x00,0x00,0x00,0x00,0x00,
  0x00,0x00,0x00,0x00,0x00,0x00,0x00,0x00,0x00,0x00,0x00,0x00,0x00,0x00,0x00,0x00,
  0x00,0x00,0x00,0x00,0x00,0x00,0x00,0x00,0x00,0x00,0x00,0x00,0x00,0x00,0x00,0x00,
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  0x00,0x00,0x00,0x00,0x00,0x00,0x00,0x00,0x00,0x00,0x00,0x00,0x00,0x00,0x00,0x00,
};

// ── Testarossa rear sprite 44x26 ────────────────────────────
#define CAR_W 44
#define CAR_H 26
static const unsigned char car_rear[] U8X8_PROGMEM = {
  0x00,0x00,0x00,0x00,0x00,0x00, 0x00,0x00,0x00,0x00,0x00,0x00,
  0x00,0xC0,0xFF,0x7F,0x00,0x00, 0x00,0x40,0x00,0x40,0x00,0x00,
  0x00,0x20,0x00,0x80,0x00,0x00, 0x00,0x20,0x00,0x80,0x00,0x00,
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  0x00,0x00,0x00,0x00,0x00,0x00, 0x00,0x00,0x00,0x00,0x00,0x00,
};

// ── State ────────────────────────────────────────────────────
bool     ntpSynced=false;
uint32_t lastNtpSync=0, lastNtpTry=0, lastTick=0, stripStart=0, lastDriveby=0, lastFeed=0;
// Power-saving resync: WiFi is OFF except during brief 24h sync windows.
bool     resyncActive=false;       // a connect attempt is in progress
uint32_t resyncStart=0;            // when the current attempt began
bool     everSynced=false;         // have we EVER gotten a good time?
int      currentStrip=0;
bool     sepVisible=true;
int32_t  cdDays=0,cdHours=0,cdMins=0,cdSecs=0;
bool     released=false;
int      prevVals[4]={-1,-1,-1,-1};
uint32_t flipUntil[4]={0,0,0,0};
int      feedX=128;
bool     feedDone=false;

// bullet impact animation state
uint32_t stripEnterTime=0;

void connectWiFi(); void syncNTP(); void computeCountdown();
void render(); void drawFlapClock();
void stripFacts(); void stripStarsHoles(); void stripBulletHoles();
void bulletHole(int,int);
void bootZoom(); void miamiScene(int scroll); void drawDriveby();
void sceneSun(); void sceneSkyline(); void scenePalm(int,int); void sceneRoad(int);
void drawScaled(const unsigned char*,int,int,int,int,int,int);
void drawScaledFat(const unsigned char*,int,int,int,int,int,int);

// ============================================================
void setup(){
  Serial.begin(115200); delay(300);
  Serial.println("\n=== GTA VI v6 ===");
  u8g2.begin();
  u8g2.setBusClock(SPI_CLOCK);
  u8g2.setContrast(CONTRAST);
  bootZoom();
  computeCountdown();
  uint32_t now=millis();
  stripStart=now; lastTick=now; lastFeed=now; lastDriveby=now;
  stripEnterTime=now;
}

// ============================================================
void loop(){
  uint32_t now=millis();

  // ---- Power-saving time sync ----
  // WiFi stays OFF while running on the internal RTC. Every 24h (or right after
  // boot if the first sync was missed) we open a brief, non-blocking window:
  // kick WiFi on, poll up to WIFI_ATTEMPT_MS. If it connects -> NTP sync, correct
  // drift, WiFi off. If not -> give up, keep current time, retry next cycle.
  // The display never blocks on any of this.
  bool dueResync = (now - lastNtpSync >= NTP_RESYNC_MS);
  bool bootRetry = (!everSynced && now - lastNtpTry >= NTP_RETRY_MS);

  if(!resyncActive && (dueResync || bootRetry)){
    // open a sync window
    resyncActive = true;
    resyncStart  = now;
    lastNtpTry   = now;
    WiFi.mode(WIFI_STA);
    WiFi.begin(WIFI_SSID, WIFI_PASSWORD);
    Serial.println("Sync window: WiFi on, attempting...");
  }

  if(resyncActive){
    if(WiFi.status()==WL_CONNECTED){
      // connected — try to grab NTP (non-blocking poll)
      static bool cfgDone=false;
      if(!cfgDone){ configTime(GMT_OFFSET_SEC,DAYLIGHT_OFFSET,NTP_SERVER,NTP_FALLBACK); cfgDone=true; }
      struct tm ti;
      if(getLocalTime(&ti, 0)){
        ntpSynced=true; everSynced=true;
        lastNtpSync=now;
        computeCountdown();
        Serial.println("Resync OK — drift corrected, WiFi off");
        WiFi.disconnect(true); WiFi.mode(WIFI_OFF);
        resyncActive=false; cfgDone=false;
      } else if(now - resyncStart >= WIFI_ATTEMPT_MS){
        // connected but NTP didn't answer in time
        Serial.println("Resync: NTP timeout, WiFi off, keep current time");
        WiFi.disconnect(true); WiFi.mode(WIFI_OFF);
        resyncActive=false; cfgDone=false;
        lastNtpSync = now - NTP_RESYNC_MS + (5UL*60UL*1000UL); // retry in ~5 min
      }
    } else if(now - resyncStart >= WIFI_ATTEMPT_MS){
      // no WiFi here (we're out) — give up quietly, keep running on RTC
      Serial.println("Resync: no WiFi, keep current time, retry next cycle");
      WiFi.disconnect(true); WiFi.mode(WIFI_OFF);
      resyncActive=false;
      if(everSynced) lastNtpSync = now;        // we have a time; wait full 24h again
      // if never synced, bootRetry will fire again in NTP_RETRY_MS
    }
  }

  // periodic drive-by (reuses miami scene)
  if(now-lastDriveby>=DRIVEBY_INTERVAL_MS){
    lastDriveby=now;
    drawDriveby();
    stripStart=millis(); lastTick=millis(); stripEnterTime=millis();
  }

  // Strip rotation. Facts strip (0) holds until its banner has scrolled
  // fully past once; other strips use the fixed hold time.
  bool advance=false;
  if(currentStrip==0){
    if(feedDone) advance=true;                         // wait for full scroll
  } else {
    if(now-stripStart>=STRIP_HOLD_MS) advance=true;
  }
  if(advance){
    currentStrip=(currentStrip+1)%NUM_STRIPS;
    stripStart=now; stripEnterTime=now;
    if(currentStrip==0){ feedX=128; feedDone=false; }
  }

  // ticker scroll when on facts strip (2px/40ms ≈ readable, full pass ~16s)
  if(currentStrip==0 && now-lastFeed>=40){
    lastFeed=now; feedX-=2; render();
  }

  // fast redraw during bullet strip so projectiles animate smoothly
  static uint32_t lastBullet=0;
  if(currentStrip==2 && now-lastBullet>=33){
    lastBullet=now; render();
  }

  if(now-lastTick>=500){
    lastTick=now; sepVisible=!sepVisible;
    if(sepVisible) computeCountdown();
    render();
  }
}

// ============================================================
void connectWiFi(){
  Serial.print("WiFi: "); Serial.println(WIFI_SSID);
  WiFi.mode(WIFI_STA); WiFi.begin(WIFI_SSID,WIFI_PASSWORD);
  uint32_t t0=millis();
  while(WiFi.status()!=WL_CONNECTED && millis()-t0<15000) delay(300);
  Serial.println(WiFi.status()==WL_CONNECTED ? "WiFi OK: "+WiFi.localIP().toString() : "WiFi FAILED");
}
void syncNTP(){
  if(WiFi.status()!=WL_CONNECTED){ Serial.println("(no WiFi)"); return; }
  configTime(GMT_OFFSET_SEC,DAYLIGHT_OFFSET,NTP_SERVER,NTP_FALLBACK);
  struct tm ti; uint32_t s=millis();
  while(!getLocalTime(&ti)&&millis()-s<8000) delay(200);
  if(getLocalTime(&ti)){ ntpSynced=true; lastNtpSync=millis(); Serial.println("NTP OK"); }
  else Serial.println("NTP FAILED");
}
void computeCountdown(){
  if(!ntpSynced){ cdDays=143;cdHours=0;cdMins=0;cdSecs=0; return; }
  time_t now=time(nullptr);
  int64_t diff=(int64_t)GTA6_RELEASE_UTC-(int64_t)now;
  if(diff<=0){ released=true; cdDays=cdHours=cdMins=cdSecs=0; return; }
  released=false;
  cdDays=(int32_t)(diff/86400); diff%=86400;
  cdHours=(int32_t)(diff/3600); diff%=3600;
  cdMins=(int32_t)(diff/60); cdSecs=(int32_t)(diff%60);
}

// ============================================================
//  Nearest-neighbor scaled sprite blit
// ============================================================
void drawScaled(const unsigned char* spr,int sw,int sh,int ox,int oy,int num,int den){
  int bpr=(sw+7)/8;
  int outW=sw*num/den, outH=sh*num/den;
  for(int y=0;y<outH;y++){
    int sy=y*den/num;
    for(int x=0;x<outW;x++){
      int sx=x*den/num;
      if((pgm_read_byte(&spr[sy*bpr+(sx>>3)])>>(sx&7))&1)
        u8g2.drawPixel(ox+x,oy+y);
    }
  }
}

// Outline-preserving scaler: each output pixel ORs its entire source
// footprint, so thin 1px outlines never break into gaps when shrinking.
void drawScaledFat(const unsigned char* spr,int sw,int sh,int ox,int oy,int num,int den){
  int bpr=(sw+7)/8;
  int outW=sw*num/den, outH=sh*num/den;
  for(int y=0;y<outH;y++){
    int sy0=y*den/num, sy1=(y+1)*den/num; if(sy1<=sy0) sy1=sy0+1; if(sy1>sh) sy1=sh;
    for(int x=0;x<outW;x++){
      int sx0=x*den/num, sx1=(x+1)*den/num; if(sx1<=sx0) sx1=sx0+1; if(sx1>sw) sx1=sw;
      bool on=false;
      for(int sy=sy0; sy<sy1 && !on; sy++)
        for(int sx=sx0; sx<sx1; sx++)
          if((pgm_read_byte(&spr[sy*bpr+(sx>>3)])>>(sx&7))&1){ on=true; break; }
      if(on) u8g2.drawPixel(ox+x,oy+y);
    }
  }
}

// ── Scene helpers ───────────────────────────────────────────
void sceneSun(){
  int cx=64,cy=30,r=12,x=r,y=0,err=0;
  while(x>=y){
    u8g2.drawPixel(cx+x,cy-y);u8g2.drawPixel(cx-x,cy-y);
    u8g2.drawPixel(cx+y,cy-x);u8g2.drawPixel(cx-y,cy-x);
    y++; if(err<=0)err+=2*y+1; if(err>0){x--;err-=2*x+1;}
  }
  for(int yy=24;yy<=30;yy+=2){
    int dy=cy-yy; int half=(int)sqrtf((float)(r*r-dy*dy));
    u8g2.drawHLine(cx-half,yy,half*2);
  }
}
void sceneSkyline(){
  const int b[][4]={{40,28,4,4},{45,25,5,7},{51,29,3,3},{74,26,4,6},{79,29,5,3},{85,27,3,5}};
  for(int i=0;i<6;i++){
    u8g2.drawBox(b[i][0],b[i][1],b[i][2],b[i][3]);
    for(int wy=b[i][1]+1;wy<b[i][1]+b[i][3];wy+=2)
      for(int wx=b[i][0]+1;wx<b[i][0]+b[i][2];wx+=2){
        u8g2.setDrawColor(0);u8g2.drawPixel(wx,wy);u8g2.setDrawColor(1);
      }
  }
}
void scenePalm(int x0,int by){
  u8g2.drawLine(x0,by,x0-2,by-11);
  u8g2.drawLine(x0-2,by-11,x0-7,by-14);
  u8g2.drawLine(x0-2,by-11,x0-6,by-9);
  u8g2.drawLine(x0-2,by-11,x0+4,by-14);
  u8g2.drawLine(x0-2,by-11,x0+5,by-10);
}
void sceneRoad(int scroll){
  u8g2.drawLine(0,63,54,33); u8g2.drawLine(127,63,74,33);
  for(int i=0;i<7;i++){
    float t=i/7.0f; int y=(int)(33+t*30); int w=(int)(1+t*4);
    int dashY=(y*8+scroll)%63;
    if(dashY>34) u8g2.drawBox(64-w/2,dashY,(w<1?1:w),2);
  }
}
void miamiScene(int scroll){
  sceneSun(); u8g2.drawHLine(0,32,128); sceneSkyline();
  scenePalm(18,32); scenePalm(110,32); sceneRoad(scroll);
}

// ============================================================
//  BOOT — VI logo pull-back into scene (also reused as drive-by)
// ============================================================
void bootZoom(){
  // ---- Phase layout (frames @ ~60fps, 16ms) ----
  const int POST_LINE = 13;                 // frames between POST line reveals
  const int N_POST    = 9;                  // number of POST lines
  const int POST_END  = N_POST*POST_LINE + 40;   // hold after last line
  // Rockstar publisher card: big R-star, flicker, pan-out to reveal text
  const int RS_HOLD   = POST_END + 175;     // ~2.8s R-star centered (flickers near end)
  const int RS_PAN    = RS_HOLD  + 45;      // pan/shrink out
  const int RS_END    = RS_PAN   + 90;      // hold with ROCKSTAR GAMES text
  // GTA VI title card
  const int LOGO_END  = RS_END   + 185;     // ~3s dead-still GTA logo hold
  const int PAN_END   = LOGO_END + 60;      // pull-back (VI shrinks into scene)
  const int CAR_END   = PAN_END  + 300;     // car drives away in the scene
  const int VI_GROW   = CAR_END  + 55;      // scene drops, VI grows back full
  const int VI_HOLD   = VI_GROW  + 130;     // hang on the full VI (~2s)
  const int TOTAL     = VI_HOLD  + 45;      // flicker out to the clock

  // kick off WiFi connect in the BACKGROUND (non-blocking)
  WiFi.mode(WIFI_STA);
  WiFi.begin(WIFI_SSID, WIFI_PASSWORD);
  bool ntpStarted = false;

  // POST line labels; results filled live for WIFI/NTP
  const char* postLab[N_POST] = {
    "LEONIDA BIOS v6.0",
    "CPU ...........",
    "MEMORY 64K ....",
    "ROM CHECK .....",
    "WANTED CTRL ...",
    "RADIO HW ......",
    "WIFI LINK .....",
    "NTP SYNC ......",
    "LOADING........"
  };

  for(int f=0; f<TOTAL; f++){
    int scroll=(f*2)%63;
    u8g2.clearBuffer();

    // ---- background networking (poll, never block) ----
    if(WiFi.status()==WL_CONNECTED && !ntpStarted){
      configTime(GMT_OFFSET_SEC, DAYLIGHT_OFFSET, NTP_SERVER, NTP_FALLBACK);
      ntpStarted = true;
    }
    if(ntpStarted && !ntpSynced){
      struct tm ti;
      if(getLocalTime(&ti, 0)){ ntpSynced=true; everSynced=true; lastNtpSync=millis(); }
    }

    if(f < POST_END){
      // ---- PHASE 1: terminal POST self-test ----
      u8g2.setFont(u8g2_font_4x6_tr);
      int shown = (f/POST_LINE)+1;
      if(shown>N_POST) shown=N_POST;
      int yy=8;
      for(int i=0;i<shown;i++){
        u8g2.drawStr(2, yy, postLab[i]);
        // results
        const char* res=nullptr;
        if(i>=1 && i<=5) res="OK";                       // static checks
        else if(i==6) res = (WiFi.status()==WL_CONNECTED) ? "OK" : "....";
        else if(i==7) res = ntpSynced ? "OK" : "....";
        if(res && f > i*POST_LINE+5) u8g2.drawStr(104, yy, res);
        yy+=6;
      }
      // blinking cursor on current line
      if((f/8)%2==0){
        int cy=8+(shown-1)*6;
        int cx=2+u8g2.getStrWidth(postLab[shown-1])+1;
        u8g2.drawBox(cx, cy-5, 4, 5);
      }
    }
    else if(f < RS_HOLD){
      // ---- PHASE 2: Rockstar R-star, big & centered, neon flicker near end ----
      float tnorm=(float)(f-POST_END)/(RS_HOLD-POST_END);
      bool show=true;
      if(tnorm>0.72f){ if(((f*7)/10)%3==0) show=false; }  // flicker like a neon tube
      if(show) drawScaledFat(rstar_logo,RSTAR_W,RSTAR_H,64-RSTAR_W/2,30-RSTAR_H/2,100,100);
    }
    else if(f < RS_PAN){
      // ---- PHASE 2b: pan/shrink out to make room for text ----
      float t=(float)(f-RS_HOLD)/(RS_PAN-RS_HOLD);
      int num=(int)((1.0f - t*0.25f)*100);   // 100% -> 75% (less shrink)
      int ow=RSTAR_W*num/100, oh=RSTAR_H*num/100;
      int cy=(int)(30 - t*4);
      drawScaledFat(rstar_logo,RSTAR_W,RSTAR_H,64-ow/2,cy-oh/2,num,100);
    }
    else if(f < RS_END){
      // ---- PHASE 2c: settled R-star + ROCKSTAR GAMES text ----
      int num=75;                       // larger (was 58) — less shrink
      int ow=RSTAR_W*num/100, oh=RSTAR_H*num/100;
      drawScaledFat(rstar_logo,RSTAR_W,RSTAR_H,64-ow/2,24-oh/2,num,100);
      u8g2.setFont(u8g2_font_5x8_tr);
      const char* rg="ROCKSTAR GAMES";
      int w=u8g2.getStrWidth(rg);
      u8g2.drawStr((128-w)/2, 61, rg);
    }
    else if(f < LOGO_END){
      // ---- PHASE 3: GTA VI title card — dead-still 3-second hold ----
      drawScaled(gta_word,WORD_W,WORD_H,0,0,100,100);
    }
    else if(f < PAN_END){
      // ---- PHASE 4: pull-back — VI shrinks toward the top ----
      float t=(float)(f-LOGO_END)/(PAN_END-LOGO_END);
      miamiScene(scroll);
      int num=(int)((1.0f - t*0.62f)*100);   // 100% -> ~38%
      int ow=VILOGO_W*num/100, oh=VILOGO_H*num/100;
      int ly=(int)(32 - t*16);               // rises toward top
      drawScaled(vi_logo,VILOGO_W,VILOGO_H,64-ow/2,ly-oh/2,num,100);
    }
    else if(f < CAR_END){
      // ---- PHASE 5: car drives AWAY up the road (rear view) ----
      float t=(float)(f-PAN_END)/(CAR_END-PAN_END);
      miamiScene(scroll);
      // smaller VI pinned high near the top edge
      int lnum=30;
      int low=VILOGO_W*lnum/100, loh=VILOGO_H*lnum/100;
      drawScaled(vi_logo,VILOGO_W,VILOGO_H,64-low/2,2,lnum,100);
      // rear-view car drives away ONCE: starts big & low (near viewer),
      // shrinks and rises toward the horizon over the whole linger.
      float cp = t;                            // single continuous pass
      int num=(int)((95 - cp*78));             // 95% -> ~17% as it drives away
      if(num<8) num=8;
      int ow=CAR_W*num/100;
      int cy=(int)(48 - cp*15);                // moves UP toward horizon (y48 -> y33)
      drawScaled(car_rear,CAR_W,CAR_H,64-ow/2,cy,num,100);
      u8g2.setFont(u8g2_font_4x6_tr);
      char load[28]; int nd=1+(f/8)%4; char dots[5]="...."; dots[nd]='\0';
      snprintf(load,sizeof(load),"LOADING: VICE CITY%s",dots);
      u8g2.drawStr(16,62,load);
    }
    else if(f < VI_GROW){
      // ---- PHASE 6: scene drops away, VI grows back to full screen ----
      float t=(float)(f-CAR_END)/(VI_GROW-CAR_END);
      int num=(int)(30 + t*70);
      if(num>100) num=100;
      int ow=VILOGO_W*num/100, oh=VILOGO_H*num/100;
      // top edge interpolates from the header position (y=2) to full-screen (y=0)
      int top=(int)((1.0f-t)*2);
      drawScaled(vi_logo,VILOGO_W,VILOGO_H,64-ow/2,top,num,100);
    }
    else if(f < VI_HOLD){
      // ---- PHASE 7: hang on the full VI ----
      drawScaled(vi_logo,VILOGO_W,VILOGO_H,0,0,100,100);
    }
    else{
      // ---- PHASE 8: flicker out to the clock (neon cut-out) ----
      // rapid on/off a few times, then leave it off so the clock takes over
      int fl=f-VI_HOLD;
      bool on = ((fl/4)%2==0) && (fl < 36);
      if(on) drawScaled(vi_logo,VILOGO_W,VILOGO_H,0,0,100,100);
    }

    u8g2.sendBuffer();
    delay(16);
  }

  // Boot done. Drop WiFi to save power — we run on the internal RTC and only
  // wake the radio for the 24h resync windows in loop().
  if(ntpSynced) Serial.println("Boot sync OK — WiFi off, running on RTC");
  else          Serial.println("Boot sync missed — will retry shortly");
  WiFi.disconnect(true);
  WiFi.mode(WIFI_OFF);
  // stagger the first scheduled resync to a full 24h from a successful boot sync;
  // if boot missed, leave lastNtpSync at 0 so bootRetry fires soon in loop().
  if(ntpSynced) lastNtpSync = millis();
  delay(200);
}

// periodic drive-by — short version of the scene with car passing through
void drawDriveby(){
  Serial.println("Drive-by!");
  const int FRAMES=240;                // ~4 seconds at 16ms
  for(int f=0; f<FRAMES; f++){
    int scroll=(f*3)%63;
    u8g2.clearBuffer();
    miamiScene(scroll);

    float t=(float)f/FRAMES;
    // car sits mid-road, rear view, swerving left<->right within the lanes.
    // road is narrow up top (~x55-74 near horizon) and wide at bottom (full width),
    // so keep the car at a mid-depth and let it weave with a sine.
    int num=70;                                 // steady mid-size
    int ow=CAR_W*num/100;
    int baseY=42;                               // mid-road depth
    // swerve amplitude scales with how wide the road is at that depth (~±26px)
    float swerve = sinf(t * 6.2831853f * 2.0f); // two full weaves over the scene
    int cx=(int)(64 - ow/2 + swerve*22);
    // slight vertical bob as it weaves (road perspective)
    int cy=(int)(baseY + fabsf(swerve)*3);
    drawScaled(car_rear,CAR_W,CAR_H,cx,cy,num,100);

    u8g2.sendBuffer();
    delay(16);
  }
  delay(150);
}

// ============================================================
void render(){
  u8g2.clearBuffer();
  drawFlapClock();
  u8g2.drawHLine(0,49,128);
  switch(currentStrip){
    case 0: stripFacts(); break;
    case 1: stripStarsHoles(); break;
    case 2: stripBulletHoles(); break;
  }
  u8g2.sendBuffer();
}

// ── Split-flap clock (FLIP label removed) ───────────────────
void drawFlapClock(){
  u8g2.setFont(u8g2_font_4x6_tr);
  u8g2.drawStr(2,7,"GTA VI DEPARTURE");
  u8g2.drawHLine(0,9,128);

  int vals[4]={(int)cdDays,(int)cdHours,(int)cdMins,(int)cdSecs};
  const char* labs[4]={"DD","HH","MM","SS"};
  for(int k=0;k<4;k++){
    int x=4+k*31;
    u8g2.drawFrame(x,12,28,26);
    u8g2.drawHLine(x,25,28);
    if(vals[k]!=prevVals[k]){ flipUntil[k]=millis()+120; prevVals[k]=vals[k]; }
    bool flipping=millis()<flipUntil[k];
    char b[5];
    if(k==0) snprintf(b,sizeof(b),"%d",vals[k]);
    else     snprintf(b,sizeof(b),"%02d",vals[k]);
    bool small=(strlen(b)>=3);
    if(small) u8g2.setFont(u8g2_font_profont17_tn);
    else      u8g2.setFont(u8g2_font_logisoso16_tr);
    int w=u8g2.getStrWidth(b);
    if(flipping) u8g2.drawBox(x+1,23,26,4);
    else u8g2.drawStr(x+(28-w)/2, small?30:31, b);
    u8g2.setFont(u8g2_font_4x6_tr);
    u8g2.drawStr(x+9,46,labs[k]);
  }
}

// ── STRIP 0 — computed facts ticker (Option A) ──────────────
void stripFacts(){
  static char buf[200];
  int weeks=(int)cdDays/7;
  long totalHours=(long)cdDays*24+cdHours;
  snprintf(buf,sizeof(buf),
    "%d DAYS TO LAUNCH   +++   %d WEEKS LEFT   +++   %ld HOURS REMAINING   +++   RELEASING NOV 19 2026   +++   ",
    (int)cdDays, weeks, totalHours);
  u8g2.setFont(u8g2_font_6x10_tr);
  int totalW=u8g2.getStrWidth(buf);
  // mark done once the whole banner has scrolled off the left edge
  if(feedX < -totalW){ feedDone=true; feedX=128; }
  u8g2.setClipWindow(0,51,128,64);
  u8g2.drawStr(feedX,61,buf);
  u8g2.setMaxClipWindow();
}

// ── STRIP 1 — wanted stars + a few holes ────────────────────
void stripStarsHoles(){
  // GTA VI 6-star wanted system. ~1 star per 24 days; all 6 lit at launch.
  int lit=constrain(6-((int)cdDays/24),1,6);
  for(int i=0;i<6;i++){
    int sx=3+i*12;
    if(i<lit) u8g2.drawXBMP(sx,52,STAR_W,STAR_H,star_filled);
    else      u8g2.drawXBMP(sx,52,STAR_W,STAR_H,star_outline);
  }
}

// ── STRIP 2 — bullets FLY IN and hit one-by-one ────────────
void stripBulletHoles(){
  const int hx[6]={12,30,52,76,98,116};
  const int hy[6]={58,56,59,57,58,56};
  uint32_t elapsed=millis()-stripEnterTime;
  const uint32_t PERIOD=700;          // ms per bullet
  const uint32_t FLIGHT=180;          // ms the bullet is visible flying in

  int completed=elapsed/PERIOD;       // holes fully landed
  if(completed>6) completed=6;

  // draw all completed holes
  for(int i=0;i<completed;i++) bulletHole(hx[i],hy[i]);

  // animate the current incoming bullet
  if(completed<6){
    uint32_t intoShot=elapsed-(uint32_t)completed*PERIOD;
    int tx=hx[completed], ty=hy[completed];
    if(intoShot<FLIGHT){
      // bullet streaks in from the left edge toward the impact point
      float p=(float)intoShot/FLIGHT;          // 0..1
      int startX=-4;
      int bx=startX+(int)((tx-startX)*p);
      int by=ty;
      // a few-pixel bullet with a short motion trail
      u8g2.drawPixel(bx,by);
      u8g2.drawPixel(bx-1,by);
      u8g2.drawHLine(bx-4,by,3);   // trail
    } else {
      // just landed — draw hole + impact flash rings
      bulletHole(tx,ty);
      uint32_t sinceHit=intoShot-FLIGHT;
      if(sinceHit<100){
        u8g2.drawCircle(tx,ty,3);
        u8g2.drawCircle(tx,ty,5);
      }
    }
  }
}

void bulletHole(int cx,int cy){
  u8g2.drawPixel(cx,cy);
  u8g2.drawPixel(cx-1,cy);u8g2.drawPixel(cx+1,cy);
  u8g2.drawPixel(cx,cy-1);u8g2.drawPixel(cx,cy+1);
  const int cr[8][2]={{0,3},{3,0},{-3,1},{0,-3},{2,2},{-2,-2},{2,-2},{-2,2}};
  for(int i=0;i<8;i++){
    int dx=cr[i][0],dy=cr[i][1];
    int st=max(abs(dx),abs(dy));
    for(int s=2;s<=st;s++) u8g2.drawPixel(cx+(dx*s)/st,cy+(dy*s)/st);
  }
}
